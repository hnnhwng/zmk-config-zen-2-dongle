## config/boards/shields/corneish_zen_dongle/Kconfig.defconfig
```kconfig
#
# Copyright (c) 2020 The ZMK Contributors
# SPDX-License-Identifier: MIT
#

if SHIELD_ZEN_DONGLE

config ZMK_KEYBOARD_NAME
    default "Corne-ish Zen"

config ZMK_SPLIT_ROLE_CENTRAL
    default y

config ZMK_USB
	default y

config ZMK_SPLIT
	default y

config ZMK_BLE
	default y


endif # SHIELD_ZEN_DONGLE
```

## config/boards/shields/zen_dongle/Kconfig.shield
```kconfig
# Copyright (c) 2020 The ZMK Contributors
# SPDX-License-Identifier: MIT

config SHIELD_ZEN_DONGLE
	def_bool $(shields_list_contains,zen_dongle)
```

## config/west.yml
```yaml
manifest:
  remotes:
    - name: zmkfirmware
      url-base: https://github.com/zmkfirmware
    - name: caksoylar
      url-base: https://github.com/caksoylar
  projects:
    - name: zmk
      remote: caksoylar
      revision: zen-8bit
      import: app/west.yml
  self:
    path: config
```
